// SPDX-License-Identifier: GPL-2.0
/*
 * Device tree overlay for the Broadcom APDS-9999
 * proximity, ambient light, and RGB color sensor.
 *
 * Compatible: brcm,apds9999
 * Interface:  I2C (address 0x52)
 * IRQ_TYPE_EDGE_FALLING = 2
 */

/dts-v1/;
/plugin/;

/ {
	compatible = "brcm,bcm2835"; /* This is the rpi SoC */

	/* Enable I2C1 (disable if already enabled in base dtb) */
	fragment@0 {
		target = <&i2c1>;
		__overlay__ {
			status = "okay"; /* means device is available and enabled */
			#address-cells = <1>; /* This specifies the number of cells needed to encode an address 1 = 32 bit */
			#size-cells = <0>; /* This specifies the number of cells needed to encode the full size. 0 since the device lives only on a single address */

			apds9999: apds9999@52 {
				compatible = "brcm,apds9999";
				reg = <0x52>;
				interrupt-parent = <&gpio>;
				interrupts = <4 2>;  /* GPIO4, falling edge (IRQ_TYPE_EDGE_FALLING = 2) */
				status = "okay";
			};
		};
	};
};
